## linux-sunxi/Kconfig
```kconfig
#
# For a description of the syntax of this configuration file,
# see Documentation/kbuild/kconfig-language.txt.
#
mainmenu "Linux/$ARCH $KERNELVERSION Kernel Configuration"

config VIDEO_ENCODER_DECODER_SUNXI
        tristate "sunxi video encoder and decoder support"
        select DMA_SHARED_BUFFER
        default y
        ---help---
          This is the driver for sunxi video decoder, including h264

config SRCARCH
	string
	option env="SRCARCH"

source "arch/$SRCARCH/Kconfig"
```

## linux-sunxi/arch/arm64/Kconfig.platforms
```kconfig
menu "Platform selection"

config ARCH_BCM_IPROC
	bool "Broadcom iProc SoC Family"
	help
	  This enables support for Broadcom iProc based SoCs

config ARCH_BERLIN
	bool "Marvell Berlin SoC Family"
	select ARCH_REQUIRE_GPIOLIB
	select DW_APB_ICTL
	help
	  This enables support for Marvell Berlin SoC Family

config ARCH_EXYNOS
	bool
	help
	  This enables support for Samsung Exynos SoC family

config ARCH_EXYNOS7
	bool "ARMv8 based Samsung Exynos7"
	select ARCH_EXYNOS
	select COMMON_CLK_SAMSUNG
	select HAVE_S3C2410_WATCHDOG if WATCHDOG
	select HAVE_S3C_RTC if RTC_CLASS
	select PINCTRL
	select PINCTRL_EXYNOS

	help
	  This enables support for Samsung Exynos7 SoC family

config ARCH_LAYERSCAPE
	bool "ARMv8 based Freescale Layerscape SoC family"
	help
	  This enables support for the Freescale Layerscape SoC family.

config ARCH_HISI
	bool "Hisilicon SoC Family"
	help
	  This enables support for Hisilicon ARMv8 SoC family

config ARCH_MEDIATEK
	bool "Mediatek MT65xx & MT81xx ARMv8 SoC"
	select ARM_GIC
	select PINCTRL
	help
	  Support for Mediatek MT65xx & MT81xx ARMv8 SoCs

config ARCH_QCOM
	bool "Qualcomm Platforms"
	select PINCTRL
	help
	  This enables support for the ARMv8 based Qualcomm chipsets.

config ARCH_ROCKCHIP
	bool "Rockchip Platforms"
	select ARCH_HAS_RESET_CONTROLLER
	select ARCH_REQUIRE_GPIOLIB
	select PINCTRL
	select PINCTRL_ROCKCHIP
	help
	  This enables support for the ARMv8 based Rockchip chipsets,
	  like the RK3368.

config ARCH_SEATTLE
	bool "AMD Seattle SoC Family"
	help
	  This enables support for AMD Seattle SOC Family

config ARCH_STRATIX10
	bool "Altera's Stratix 10 SoCFPGA Family"
	help
	  This enables support for Altera's Stratix 10 SoCFPGA Family.

config ARCH_TEGRA
	bool "NVIDIA Tegra SoC Family"
	select ARCH_HAS_RESET_CONTROLLER
	select ARCH_REQUIRE_GPIOLIB
	select CLKDEV_LOOKUP
	select CLKSRC_MMIO
	select CLKSRC_OF
	select GENERIC_CLOCKEVENTS
	select HAVE_CLK
	select PINCTRL
	select RESET_CONTROLLER
	help
	  This enables support for the NVIDIA Tegra SoC family.

config ARCH_TEGRA_132_SOC
	bool "NVIDIA Tegra132 SoC"
	depends on ARCH_TEGRA
	select PINCTRL_TEGRA124
	select USB_ULPI if USB_PHY
	select USB_ULPI_VIEWPORT if USB_PHY
	help
	  Enable support for NVIDIA Tegra132 SoC, based on the Denver
	  ARMv8 CPU.  The Tegra132 SoC is similar to the Tegra124 SoC,
	  but contains an NVIDIA Denver CPU complex in place of
	  Tegra124's "4+1" Cortex-A15 CPU complex.

config ARCH_SPRD
	bool "Spreadtrum SoC platform"
	help
	  Support for Spreadtrum ARM based SoCs

config ARCH_THUNDER
	bool "Cavium Inc. Thunder SoC Family"
	help
	  This enables support for Cavium's Thunder Family of SoCs.

config ARCH_VEXPRESS
	bool "ARMv8 software model (Versatile Express)"
	select ARCH_REQUIRE_GPIOLIB
	select COMMON_CLK_VERSATILE
	select POWER_RESET_VEXPRESS
	select VEXPRESS_CONFIG
	help
	  This enables support for the ARMv8 software model (Versatile
	  Express).

config ARCH_XGENE
	bool "AppliedMicro X-Gene SOC Family"
	help
	  This enables support for AppliedMicro X-Gene SOC Family

config ARCH_ZYNQMP
	bool "Xilinx ZynqMP Family"
	help
	  This enables support for Xilinx ZynqMP Family

config ARCH_SUNXI
	bool "Allwinner SoC Family"
	select PINCTRL
	select SUN4I_TIMER
	help
	  This enables support for Allwinner SUNXI SoC family

if ARCH_SUNXI
choice
	prompt "Select the architecture of SoC"
	default ARCH_SUN50I
	help
	  Select the architecture for SoC
	  sunxi
	  `-- sun50i ----- Cortex-A53 based Family SoCs

	config ARCH_SUN50I
	bool "Allwinner SUN50I"
endchoice

# Select the wafer with sun50i

if ARCH_SUN50I
choice
	prompt "Select the wafer with arch sun50i"
	default ARCH_SUN50IW1
	help
	  Select the wafer with arch sun50i

config ARCH_SUN50IW1
	bool "Allwinner SUN50IW1 SoCs"
	help
	  Support for Allwinner SUN50IW1 SoC family

config ARCH_SUN50IW2
	bool "Allwinner SUN50IW2 SoCs"
	help
	  Support for Allwinner SUN50IW2 SoC family

config ARCH_SUN50IW3
	bool "Allwinner SUN50IW3 SoCs"
	help
	  Support for Allwinner SUN50IW3 SoC family

config ARCH_SUN50IW6
	bool "Allwinner SUN50IW6 SoCs"
	help
	  Support for Allwinner SUN50IW6 SoC family
endchoice
endif

# Select the SoC with specific arch and wafer

if ARCH_SUN50IW1
choice
	prompt "Select the SoC with wafer ARCH_SUN50IW1"
	default ARCH_SUN50IW1P1
	help
	  Select the SoC with wafer ARCH_SUN50IW1

config ARCH_SUN50IW1P1
	bool "Allwinner SUN50IW1P1"
	select HAVE_UNSTABLE_SCHED_CLOCK
	select SUNXI_SMC
endchoice
endif

if ARCH_SUN50IW2
choice
	prompt "Select the SoC with wafer ARCH_SUN50IW2"
	default ARCH_SUN50IW2P1
	help
	  Select the SoC with wafer ARCH_SUN50IW2

config ARCH_SUN50IW2P1
	bool "Allwinner SUN50IW2P1"
	select HAVE_UNSTABLE_SCHED_CLOCK
	select SUNXI_SMC
endchoice
endif

if ARCH_SUN50IW3
choice
	prompt "Select the SoC with wafer ARCH_SUN50IW3"
	default ARCH_SUN50IW3P1
	help
	  Select the SoC with wafer ARCH_SUN50IW3

config ARCH_SUN50IW3P1
	bool "Allwinner SUN50IW3P1"
	select SUNXI_SMC
endchoice
endif

if ARCH_SUN50IW6
choice
	prompt "Select the SoC with wafer ARCH_SUN50IW6"
	default ARCH_SUN50IW6P1
	help
	  Select the SoC with wafer ARCH_SUN50IW6

config ARCH_SUN50IW6P1
	bool "Allwinner SUN50IW6P1"
	select SUNXI_SMC
	select ARCH_SUPPORTS_MSI
endchoice
endif

# Select the board between FPGA and EVB

choice
	prompt "Allwinner development boards"
	depends on ARCH_SUNXI
	default FPGA_V4_PLATFORM

config FPGA_V4_PLATFORM
	bool "FPGAv4 board"
	help
	  Support for Allwinner's FPGAv4 board

	config FPGA_V7_PLATFORM
	bool "FPGAv7 board"
	help
	  Support for Allwinner's FPGAv7 board

	config EVB_PLATFORM
	bool "EVB board"
	help
	  Support for Allwinner's EVB board
endchoice

config SUNXI_SOC_NAME
	string "The name of SUNXI SoC"
	default ""
	help
	  Used for /sysfs/.../sysinfo.

endif # end of ARCH_SUNXI

endmenu
```

## linux-sunxi/drivers/char/sunxi-idc/Kconfig
```kconfig
config SUNXI_IDC
	tristate "allwinnertech Interrupt-Defer-Controller driver"
	depends on ARCH_SUN8IW15
	default n
	help
	  This is an option for interrupt defer controller driver.

config SUNXI_IDC_DEBUG
	tristate "allwinnertech Interrupt-Defer-Controller driver debug"
	depends on SUNXI_IDC
	default n
	help
	  This is an option for debug interrupt defer controller driver.
```

## linux-sunxi/drivers/gpu/drm/sunxi/Kconfig
```kconfig
menuconfig DRM_SUNXI
    tristate "DRM Support for Allwinnertech SoC A and R Series"
    depends on DRM && ARCH_SUNXI
    select DRM_KMS_HELPER
    help
      Choose this for Allwintertech  A64 R18 and others.

config DRM_SUNXI_ROTATER
    bool "Support the sunxi rotate device"
    depends on DRM_SUNXI
    help
      use sunxi drm rotater.

config DRM_SUNXI_HDMI
    bool "Support the sunxi hdmi device"
    depends on DRM_SUNXI
    help
      support sunxi drm hdmi.
```

## linux-sunxi/drivers/input/touchscreen/ft6x/Kconfig
```kconfig
#
#  Touchscreen ft6x driver configuration
#

config TOUCHSCREEN_FT6X_TS
       tristate  "ft6x touchscreen driver"
       default m
       depends on INPUT && I2C
       help
         ft6x touchscreen driver


config FT6X_MULTITOUCH_TS
bool  "support ft6x touchscreen to multtouch"
	depends on TOUCHSCREEN_FT6X_TS
	default n
	help
	  Say Y here if you want to open multtouch.

	  If unsure, say N.
```

## linux-sunxi/drivers/input/touchscreen/gt9xx/Kconfig
```kconfig
#
#  Touchscreen driver configuration
#
config  TOUCHSCREEN_GT9XX
       tristate  "gt9xxnew touchscreen driver"      
       depends on INPUT && I2C
       default m
       help
         gt9xx touchscreen driver    
         
```

## linux-sunxi/drivers/media/platform/sunxi-aio/Kconfig
```kconfig
#
# embedded vision engine device configuration
#
config SUNXI_AIO
	tristate "AIO debugfs driver"
	default m
	---help---
	This is the driver for allwinner platform audio input/output debugfs module.
	To compile this driver as a module, choose M here: the
	module will be called sunxi_aio.
```

## linux-sunxi/drivers/media/platform/sunxi-vin/Kconfig
```kconfig
config CSI_VIN
	tristate "v4l2 new driver for SUNXI"
	default m
	select VIDEOBUF2_DMA_CONTIG

config CCI
	tristate "use internal cci"
	default m

config PIPELINE_RESET
	bool "use pipeline reset when timeout"
	default n
```

## linux-sunxi/drivers/misc/kcrash/Kconfig
```kconfig
menuconfig KCRASH
	bool "Kernel Crash dumper"
	default n
	---help---
	  Dump log or save infomations when kernel crash.
	  Crash events like oops, panic, oom and so on.

if KCRASH
	config KCRASH_PANIC
		bool "Panic Event"
		default y
		---help---
		  Dump log when panic.
		  The log is writen to partition named "kcrash" with offset 0.

endif
```

## linux-sunxi/drivers/thermal/sunxi_thermal/sunxi_cooling_device/Kconfig
```kconfig
#
# SUNXI cooling device drivers configuration
#
config SUNXI_BUDGET_COOLING
	tristate "sunxi budget cooling"
	depends on ARCH_SUNXI
	help
	  Adds sunxi cpu budget cooling devices, and these cooling devices can be
	  bound to thermal zone trip points. When a trip point reached, the
	  bound cpufreq cooling device turns active to set CPU frequency low to
	  cool down the CPU.

config SUNXI_BUDGET_COOLING_CPU_DVFS
	tristate "sunxi budget cooling about CPU-DVFS"
	depends on THERMAL_OF
	depends on CPU_FREQ
	depends on SUNXI_BUDGET_COOLING
	help
	  Adds CPU cooling device about CPU dynamic-voltage-frequence-scaling.

config SUNXI_BUDGET_COOLING_HOTPLUG
	tristate "sunxi budget cooling about Hotplug"
	depends on THERMAL_OF
	depends on HOTPLUG_CPU
	depends on SUNXI_BUDGET_COOLING
	help
	  Adds CPU cooling device use hotplug limit.

config SUNXI_BUDGET_COOLING_GPU_FS
	tristate "sunxi budget cooling about GPU FS"
	depends on THERMAL_OF
	depends on SUNXI_BUDGET_COOLING
	help
	  Adds sunxi gpu cooling devices, and these cooling devices can be
	  bound to thermal zone trip points. When a trip point reached, the
	  gpu cooling device turns active to set gpu frequency low to
	  cool down the CPU.

config SUNXI_BUDGET_COOLING_FREQTBL
	tristate "sunxi cpu budget cooling parse VF table support"
	depends on SUNXI_BUDGET_COOLING
	depends on ARCH_SUN8IW6
	help
	Add sunxi budget cooling frequecy tables.Get cpu frequency tables from
	cpu policy.Cpu budget cooling do not define fixed cpu frequecy point,just
	get these frequecy point from opp or dvfs_tables
```

## sunxi-pack/allwinner/generic/image/Config.in
```kconfig
config SUNXI_SD_BOOT_PART
	bool "Build filesystem for Boot (SD Card) partition"
	default y

config SUNXI_SD_BOOT_PARTSIZE
	int "Boot (SD Card) filesystem partition size (in MB)"
	depends on SUNXI_SD_BOOT_PART
	default 4

choice
	prompt "Boot (SD Card) Kernel format"
	default uImage

	config SUNXI_SD_BOOT_KERNEL_FORMAT_UIMAGE
	bool "uImage"

	config SUNXI_SD_BOOT_KERNEL_FORMAT_BOOTIMG
	bool "boot.img"
endchoice

config SUNXI_SMALL_STORAGE_OTA
	bool "For storage less than 32M, enable this when using ota"
	default n

config SUNXI_RECOVERY_INITRAMFS_PART
	bool "Build filesystem for Boot-Recovery initramfs partition"
	default y

config SUNXI_RECOVERY_INITRAMFS_PARTSIZE
	int "Boot-Recovery initramfs filesystem partition size (in MB)"
	depends on SUNXI_RECOVERY_INITRAMFS_PART
	default 7


choice
	prompt "Boot-Recovery initramfs Kernel format"
	default uImage

	config SUNXI_RECOVERY_INITRAMFS_KERNEL_FORMAT_UIMAGE
	bool "uImage"

	config SUNXI_RECOVERY_INITRAMFS_KERNEL_FORMAT_BOOTIMG
	bool "boot.img"
endchoice
```
